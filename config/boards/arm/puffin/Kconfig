## config/boards/arm/puffin/Kconfig.board
```kconfig
# Maker Diary nrf52840 board configuration

# Copyright (c) 2020 The ZMK Contributors
# SPDX-License-Identifier: MIT
# Using Holyoit 18010 module

config BOARD_PUFFIN
    bool "puffin"
    depends on SOC_NRF52840_QIAA
```

## config/boards/arm/puffin/Kconfig.defconfig
```kconfig
# Puffin board configuration

# Copyright (c) 2020 The ZMK Contributors
# SPDX-License-Identifier: MIT

if BOARD_PUFFIN_RIGHT

config ZMK_SPLIT_ROLE_CENTRAL
	default y
	
config ZMK_KEYBOARD_NAME
	default "Puffin"
	
endif 

if BOARD_PUFFIN_RIGHT || BOARD_PUFFIN_LEFT

config BOARD
    default "puffin"

config ZMK_KEYBOARD_NAME
    default "puffin"	
	
config SPI
	default y

config BT_CTLR
    default BT

config ZMK_BLE
    default y

config ZMK_USB
    default y

config ZMK_SPLIT
	default y
	
	if USB

	config USB_NRFX
		default y
		
	config USB_DEVICE_STACK
		default y

	endif # USB
	
endif 
```

## config/boards/arm/puffin/kconfig.board
```kconfig
# Maker Diary nrf52840 board configuration

# Copyright (c) 2020 The ZMK Contributors
# SPDX-License-Identifier: MIT

config BOARD_PUFFIN
    bool "puffin"
    depends on SOC_NRF52840_QIAA
```

## config/boards/arm/puffin/kconfig.degconfig
```kconfig
# Copyright (c) 2020 The ZMK Contributors
# SPDX-License-Identifier: MIT

if BOARD_PUFFIN

config BOARD
    default "puffin"

if USB_DEVICE_STACK

config USB_NRFX
    default y

endif # USB_DEVICE_STACK

config BT_CTLR
    default BT

config ZMK_BLE
    default y

config ZMK_USB
    default y

endif # BOARD_PUFFIN
```

## config/boards/arm/puffin/puffin_left_defconfig
```kconfig
# SPDX-License-Identifier: MIT

CONFIG_SOC_SERIES_NRF52X=y
CONFIG_SOC_NRF52840_QIAA=y
CONFIG_BOARD_PUFFIN_LEFT=y

# Enable MPU
CONFIG_ARM_MPU=y

# enable GPIO
CONFIG_GPIO=y

CONFIG_ZMK_SLEEP=y
CONFIG_SPI=y
CONFIG_USE_DT_CODE_PARTITION=y
CONFIG_BUILD_OUTPUT_UF2=y
CONFIG_ZMK_USB_LOGGING=y


CONFIG_MPU_ALLOW_FLASH_WRITE=y
CONFIG_NVS=y
CONFIG_SETTINGS_NVS=y
CONFIG_FLASH=y
CONFIG_FLASH_PAGE_LAYOUT=y
CONFIG_FLASH_MAP=y
#CONFIG_MOUSE_LAYER_INDEX=5
#CONFIG_LAYER_ACTIVE_MS=400

CONFIG_ZMK_BLE_CLEAR_BONDS_ON_START=y
```

## config/boards/arm/puffin01/Kconfig.board
```kconfig
# Maker Diary nrf52840 board configuration

# Copyright (c) 2020 The ZMK Contributors
# SPDX-License-Identifier: MIT
# Using Holyoit 18010 module

config BOARD_PUFFIN01
    bool "puffin01"
    depends on SOC_NRF52840_QIAA


config BOARD_PUFFIN1_LEFT
    bool "puffin01 left"
    depends on SOC_NRF52840_QIAA

config BOARD_PUFFIN01_RIGHT
    bool "puffin01 right"
    depends on SOC_NRF52840_QIAA
```

## config/boards/arm/puffin01/Kconfig.defconfig
```kconfig
# Puffin board configuration

# Copyright (c) 2020 The ZMK Contributors
# SPDX-License-Identifier: MIT

if BOARD_PUFFIN01_RIGHT

config ZMK_SPLIT_ROLE_CENTRAL
	default y
	
config ZMK_KEYBOARD_NAME
	default "Puffin01"
	
endif 

if BOARD_PUFFIN01_RIGHT || BOARD_PUFFIN01_LEFT

config BOARD
    default "puffin01"	
	
config SPI
	default y

config BT_CTLR
    default BT

config ZMK_BLE
    default y

config ZMK_USB
    default y

config ZMK_SPLIT
	default y
	
	if USB

	config USB_NRFX
		default y
		
	config USB_DEVICE_STACK
		default y

	endif # USB
	
endif 
```

## config/boards/nrf/puffin/Kconfig.board
```kconfig
# Maker Diary nrf52840 M.2 board configuration

# Copyright (c) 2020 The ZMK Contributors
# SPDX-License-Identifier: MIT

config BOARD_PUFFIN
    bool "puffin"
    depends on SOC_NRF52840_QIAA
    
config SOC_DCDC_NRF52X
    bool "nrf fam"
    depends on SOC_FAMILY_NRF
```

## config/west.yml
```yaml
manifest:
  remotes:
    - name: zmkfirmware
      url-base: https://github.com/petejohanson
    - name: nrf
      url-base: https://github.com/nrfconnect
  projects:
    - name: zmk
      remote: zmkfirmware
      revision: feat/pointers-move-scroll
      import: app/west.yml
    - name: sdk-nrf
      remote: nrf
      revision: main
      import: zephyr/module.yml
  self:
    path: config
```
